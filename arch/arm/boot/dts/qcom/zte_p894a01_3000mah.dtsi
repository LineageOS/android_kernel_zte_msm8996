
qcom,zte_p894a01_3000mah {
	/* #1860341_ZTE_P894A01_3000mAh_averaged_MasterSlave_Jan12th2015*/
	qcom,max-voltage-uv = <4350000>;
	qcom,nom-batt-capacity-mah = <3000>;
	qcom,batt-id-kohm = <180>;
	qcom,chg-term-ua = <150000>;
	qcom,battery-beta = <4050>;
	qcom,battery-type = "zte_p894a01_3000mah";
	qcom,checksum = <0x6465>;
	qcom,gui-version = "PMI8994GUI - 2.1.5.10";
	qcom,fg-profile-data = [
		 FD 83 D2 7D 
		 B4 81 4C 7C 
		 75 83 59 7C 
		 01 8B DD 94 
		 EF 81 12 99 
		 05 B6 C7 C0 
		 5E 19 09 88 
		 E4 7D 93 81 
		 0E 7C 54 83 
		 FF 59 20 81 
		 99 8C 4B 82 
		 5B 98 CE B5 
		 32 C1 5E 19 
		 17 0C 32 59 
		 CE 6E 29 FC 
		 07 37 EC 45 
		 CF 30 00 00 
		 9E 4C 25 32 
		 56 3A 00 00 
		 00 00 00 00 
		 00 00 00 00 
		 EB 70 0E 71 
		 D6 6D EE 88 
		 24 6F 26 41 
		 26 58 91 80 
		 FE 6D 28 55 
		 CD 8D 52 B0 
		 26 D9 60 3C 
		 5D A0 71 0C 
		 28 00 FF 36 
		 F0 11 30 03 
		 00 00 00 00 
	];
};
