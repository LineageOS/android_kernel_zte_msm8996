/* Copyright (c) 2013-2015, The Linux Foundation. All rights reserved.
 *
 * This program is free software; you can redistribute it and/or modify
 * it under the terms of the GNU General Public License version 2 and
 * only version 2 as published by the Free Software Foundation.
 *
 * This program is distributed in the hope that it will be useful,
 * but WITHOUT ANY WARRANTY; without even the implied warranty of
 * MERCHANTABILITY or FITNESS FOR A PARTICULAR PURPOSE.  See the
 * GNU General Public License for more details.
 */

&mdss_mdp {
	dsi_dual_zte_samsung_5p5_wqhd_cmd: qcom,mdss_dsi_zte_samsung_5p5_wqhd_dualmipi_cmd{
		qcom,mdss-dsi-panel-name = "zteSAM_S6E3HA3_SAM_25601440_5P5Inch";
		qcom,mdss-dsi-panel-type = "dsi_cmd_mode";
		qcom,cont-splash-enabled;
		qcom,mdss-dsi-panel-framerate = <60>;
		qcom,mdss-dsi-virtual-channel-id = <0>;
		qcom,mdss-dsi-stream = <0>;
		qcom,mdss-dsi-panel-width = <720>;
		qcom,mdss-dsi-panel-height = <2560>;
		qcom,mdss-dsi-h-front-porch = <140>;
		qcom,mdss-dsi-h-back-porch = <66>;
		qcom,mdss-dsi-h-pulse-width = <16>;
		qcom,mdss-dsi-h-sync-skew = <0>;
		qcom,mdss-dsi-v-back-porch = <8>;
		qcom,mdss-dsi-v-front-porch = <16>;
		qcom,mdss-dsi-v-pulse-width = <16>;
		qcom,mdss-dsi-h-left-border = <0>;
		qcom,mdss-dsi-h-right-border = <0>;
		qcom,mdss-dsi-v-top-border = <0>;
		qcom,mdss-dsi-v-bottom-border = <0>;
		qcom,mdss-dsi-bpp = <24>;
		qcom,mdss-dsi-color-order = "rgb_swap_rgb";
		qcom,mdss-dsi-underflow-color = <0xff>;
		qcom,mdss-dsi-border-color = <0>;
		qcom,mdss-dsi-h-sync-pulse = <0>;
		qcom,mdss-dsi-traffic-mode = "non_burst_sync_event";
		qcom,mdss-dsi-bllp-eof-power-mode;
		qcom,mdss-dsi-bllp-power-mode;
		qcom,cmd-sync-wait-broadcast;
		qcom,mdss-pan-physical-width-dimension = <68>;
		qcom,mdss-pan-physical-height-dimension = <121>;
		qcom,mdss-dsi-lane-0-state;
		qcom,mdss-dsi-lane-1-state;
		qcom,mdss-dsi-lane-2-state;
		qcom,mdss-dsi-lane-3-state;

		//qcom,mdss-dsi-hor-line-idle = 	<0 40 256>,
		//				<40 120 128>,
		//				<120 240 64>;

		qcom,mdss-dsi-panel-timings-phy-v2 = [
			23 1e 08 09 05 03 04 a0
			23 1e 08 09 05 03 04 a0
			23 1e 08 09 05 03 04 a0
			23 1e 08 09 05 03 04 a0
			23 1a 08 09 05 03 04 a0];
		//qcom,mdss-dsi-panel-status-check-mode = "te_signal_check";
		qcom,mdss-dsi-panel-status-read-length = <1>;
		qcom,esd-check-enabled; //enables ESD
		qcom,mdss-dsi-panel-status-command = [06 01 00 01 05 00 01 0A ]; //read command to be sent
		qcom,mdss-dsi-panel-status-command-state = "dsi_hs_mode"; //link state for the read command
		qcom,mdss-dsi-panel-status-check-mode = "reg_read"; //register read approach
		qcom,mdss-dsi-panel-status-value = <0xb4>; //expected success value if the panel is in good state
		//zte,lcd-esd-gpio = <&tlmm 53 0>; //zte,esd 0122,gpio mode depends on "reg_read" mode
		//zte,lcd-esd-gpio-enable; //zte,esd 0122

		zte,esd-interrupt-gpio = <&tlmm 53 0>;/*zte,esd interrupt mode 0205 */

//		qcom,partial-update-enabled;
//		qcom,partial-update-roi-merge;
//		qcom,panel-roi-alignment = <8 8 8 8 8 8>;
		qcom,mdss-dsi-reset-sequence = <1 2>, <0 1>, <1 5>;

		qcom,mdss-dsi-t-clk-post = <0x03>;
		qcom,mdss-dsi-t-clk-pre = <0x2b>; //<0x29>;
		qcom,mdss-dsi-dma-trigger = "trigger_sw";
		qcom,mdss-dsi-mdp-trigger = "none";
		qcom,mdss-dsi-te-pin-select = <1>;
		qcom,mdss-dsi-wr-mem-start = <0x2c>;
		qcom,mdss-dsi-wr-mem-continue = <0x3c>;
		qcom,mdss-dsi-te-dcs-command = <1>;
		qcom,mdss-dsi-te-check-enable;
		qcom,mdss-dsi-te-using-te-pin;
		qcom,ulps-enabled;
		qcom,mdss-mdp-transfer-time-us = <12500>;
		qcom,mdss-dsi-lp11-init;
		qcom,mdss-dsi-bl-pmic-control-type ="bl_ctrl_dcs";
		qcom,mdss-dsi-bl-min-level = <1>;
		qcom,mdss-dsi-bl-max-level = <255>;
		qcom,mdss-dsi-on-command = [
			05 01 00 00 05 00 01 11
			39 01 00 00 00 00 03 f0 5a 5a
			39 01 00 00 00 00 02 c4 03
			39 01 00 00 00 00 02 f9 03
			39 01 00 00 00 00 14 c2 00 08 d8 d8 00 80 2b 05 08 0e 07 0b 05 0d 0a 15 13 20 1e
			39 01 00 00 00 00 02 ed 45 //add err flag for esd test
			39 01 00 00 00 00 0a f6 42 57 37 00 aa cc d0 00 00 //add for esd 0112
			//39 01 00 00 00 00 02 b0 01 //start-20160614
			//39 01 00 00 00 00 02 b1 60 //set diming to 4 frame -20160614
			//39 01 00 00 00 00 02 f7  03 //end-20160614
			39 01 00 00 78 00 03 f0 a5 a5
			05 01 00 00 01 00 01 12 //add for esd 0112
			39 01 00 00 00 00 02 35 00
			//39 01 00 00 00 00 02 51 a0
			39 01 00 00 00 00 02 53 20

			05 01 00 00 10 00 01 29
		];
		qcom,mdss-dsi-on-command-acl = [
			05 01 00 00 05 00 01 11
			39 01 00 00 00 00 03 f0 5a 5a
			39 01 00 00 00 00 02 c4 03
			39 01 00 00 00 00 02 f9 03
			39 01 00 00 00 00 14 c2 00 08 d8 d8 00 80 2b 05 08 0e 07 0b 05 0d 0a 15 13 20 1e
			39 01 00 00 00 00 02 ed 45
			39 01 00 00 00 00 0a f6 42 57 37 00 aa cc d0 00 00
			39 01 00 00 00 00 03 f0 a5 a5
			05 01 00 00 01 00 01 12
			39 01 00 00 00 00 02 35 00
			//39 01 00 00 00 00 02 51 a0
			39 01 00 00 00 00 02 53 20
			39 01 00 00 00 00 02 55 02
			05 01 00 00 10 00 01 29
		];
		/*samsun 5.5 2k panel could only use hs mode 20160107 */
		qcom,mdss-dsi-on-command-state = "dsi_hs_mode";
		qcom,mdss-dsi-post-mode-switch-on-command =
			[05 01 00 00 0a 00 01 00
			/* Soft reset, wait 10ms */
			15 01 00 00 0a 00 02 3a 77
			/* Set Pixel format (24 bpp) */
			39 01 00 00 0a 00 05 2a 00 00 04 ff
			/* Set Column address */
			39 01 00 00 0a 00 05 2b 00 00 05 9f
			/* Set page address */
			15 01 00 00 0a 00 02 35 00
			/* Set tear on */
			39 01 00 00 0a 00 03 44 00 00
			/* Set tear scan line */
			15 01 00 00 0a 00 02 51 ff
			/* write display brightness */
			15 01 00 00 0a 00 02 53 24
			/* write control brightness */
			15 01 00 00 0a 00 02 55 00
			/* CABC brightness */
			05 01 00 00 78 00 01 11
			/* exit sleep mode, wait 120ms */
			23 01 00 00 0a 00 02 b0 00
			/* MCAP */
			29 01 00 00 0a 00 02 b3 14
			/* Interface setting */
			29 01 00 00 0a 00 14 ce 7d 40 48 56 67
			78 88 98 a7 b5 c3 d1 de e9 f2 fa ff 04
			00    /* Backlight control 4 */
			23 01 00 00 0a 00 02 b0 03
			/* MCAP */
			05 01 00 00 10 00 01 29];
			/* Set display on, wait 16ms */
			qcom,mdss-dsi-post-mode-switch-on-command-state = "dsi_hs_mode";
			qcom,mdss-dsi-off-command =[
			39 01 00 00 00 00 02 51 00
			05 01 00 00 32 00 02 28 00
			05 01 00 00 78 00 02 10 00];
			qcom,mdss-dsi-off-command-state = "dsi_hs_mode";
			//qcom,dynamic-mode-switch-enabled;
			//qcom,dynamic-mode-switch-type = "dynamic-switch-immediate";
			qcom,video-to-cmd-mode-switch-commands =
			[23 00 00 00 00 00 02 b0 00
			29 00 00 00 00 00 02 b3 0c
			23 01 00 00 00 00 02 b0 03];
			qcom,cmd-to-video-mode-switch-commands =
			[23 00 00 00 00 00 02 b0 00
			29 00 00 00 00 00 02 b3 1c
			23 01 00 00 00 00 02 b0 03];
	};
};
