## drivers/input/fingerprint/gf3238_driver/Kconfig
```kconfig
config FINGERPRINT_GOODIX_GF3238M
	tristate "GOODIX GF3238 fingerprint driver"
	default n
```

## drivers/input/fingerprint/gf3238_kernel/Kconfig
```kconfig
config FINGERPRINT_GOODIX_GF3238M
	tristate "GOODIX fingerprint driver"
	default n
```

## drivers/input/fingerprint/goodix/Kconfig
```kconfig
config FINGERPRINT_GOODIX_GF3118M
	tristate "GOODIX fingerprint driver"
	default n
```

## drivers/input/touchscreen/gt1x/Kconfig
```kconfig
menuconfig TOUCHSCREEN_GT1X
	bool "goodix gt1x touchscreen"
	default n
	help
	  Say Y here if you have a goodix gt1x touchscreen connected
	  to your system.

	  If unsure, say N.
```

## drivers/input/touchscreen/gt1x_stress/Kconfig
```kconfig
menuconfig STRESS_TOUCHSCREEN_GT1X
	bool "ndt stress and goodix gt1x touchscreen"
	default n
	help
	  Say Y here if you have ndt stress sensor and goodix gt1x touchscreen connected
	  to your system.

	  If unsure, say N.
```

## drivers/input/touchscreen/gt1x_zte/Kconfig
```kconfig
#
# Synaptics DSX touchscreen driver configuration
#
menuconfig TOUCHSCREEN_GT1X_ZTE
	bool "GT1X touchscreen"
	help
	  Say Y here if you have a Synaptics DSX touchscreen connected
	  to your system.

	  If unsure, say N.
```

## drivers/input/touchscreen/synaptics_dsx_zte/Kconfig
```kconfig
#
# Synaptics DSX ZTE touchscreen driver configuration
#
menuconfig TOUCHSCREEN_SYNAPTICS_DSX_ZTE
	bool "Synaptics DSX ZTE touchscreen"
	default n
	help
	  Say Y here if you have a Synaptics DSX touchscreen connected
	  to your system.

	  If unsure, say N.

if TOUCHSCREEN_SYNAPTICS_DSX_ZTE

choice
	default TOUCHSCREEN_SYNAPTICS_DSX_I2C_ZTE
	prompt "Synaptics DSX ZTE bus interface"
config TOUCHSCREEN_SYNAPTICS_DSX_I2C_ZTE
	bool "RMI over I2C"
	depends on I2C
endchoice

config TOUCHSCREEN_SYNAPTICS_DSX_CORE_ZTE
	tristate "Synaptics DSX ZTE core driver module"
	depends on I2C || SPI_MASTER
	help
	  Say Y here to enable basic touch reporting functionality.

	  If unsure, say N.

	  To compile this driver as a module, choose M here: the
	  module will be called synaptics_dsx_core.

config TOUCHSCREEN_SYNAPTICS_DSX_RMI_DEV_ZTE
	tristate "Synaptics DSX ZTE RMI device module"
	depends on TOUCHSCREEN_SYNAPTICS_DSX_CORE_ZTE
	help
	  Say Y here to enable support for direct RMI register access.

	  If unsure, say N.

	  To compile this driver as a module, choose M here: the
	  module will be called synaptics_dsx_rmi_dev.

config TOUCHSCREEN_SYNAPTICS_DSX_FW_UPDATE_ZTE
	tristate "Synaptics DSX ZTE firmware update module"
	depends on TOUCHSCREEN_SYNAPTICS_DSX_CORE_ZTE
	help
	  Say Y here to enable support for doing firmware update.

	  If unsure, say N.

	  To compile this driver as a module, choose M here: the
	  module will be called synaptics_dsx_fw_update.

config TOUCHSCREEN_SYNAPTICS_DSX_TEST_REPORTING_ZTE
	tristate "Synaptics DSX ZTE test reporting module"
	depends on TOUCHSCREEN_SYNAPTICS_DSX_CORE_ZTE
	help
	  Say Y here to enable support for retrieving production test reports.

	  If unsure, say N.

	  To compile this driver as a module, choose M here: the
	  module will be called synaptics_dsx_test_reporting.

endif
```

## drivers/usb/typec/Kconfig
```kconfig
#
# USB Typec driver configuration
#

config USB_TYPEC
       bool "USB TYPEC"
       depends on I2C
       depends on USB
       ---help---
       Say Y here if you want to use USB TypeC.

config USB_HD3SS3220
       bool "USB HD3SS3220"
       depends on USB_TYPEC
       ---help---
       Say Y here if you want to use the TI HD3SS3220 chip.

config USB_PI5USB302
       bool "USB PI5USB302"
       depends on USB_TYPEC
       ---help---
       Say Y here if you want to use the Pericom PI5USB302 chip.
```

## sound/soc/codecs/ak4490/Kconfig
```kconfig
menu "AK4490 HEADPHONE chip"

config SND_SOC_AK4490
	bool "AK4490"  
	---help---
	  Add ak4490 configuration

endmenu
```
